// SPDX-License-Identifier: BSD-3-Clause
/*
 * Copyright (c) Qualcomm Technologies, Inc. and/or its subsidiaries.
 */

/dts-v1/;
/plugin/;

&soc {
	st54spi_gpio {
		status = "ok";
		compatible = "st,st54spi_gpio";
		/* gpio used as SE_nRESET */
		gpio-power_nreset = <&tlmm 137 0x00>;
	};
};

/ {
	model = "Qualcomm Technologies, Inc. Shikra SoC";
	compatible = "qcom,shikra";
	qcom,board-id = <0x10021 0x0>, <0x10021 0x300>, <0x10021 0x400>, <0x10021 0x500>,
			<0x10033 0x0>, <0x10033 0x300>, <0x10033 0x400>, <0x10033 0x500>,
			<0x20033 0x0>, <0x20033 0x300>, <0x20033 0x400>, <0x20033 0x500>,
			<0x70033 0x0>, <0x70033 0x300>, <0x70033 0x400>, <0x70033 0x500>,
			<0x80033 0x0>, <0x80033 0x300>, <0x80033 0x400>, <0x80033 0x500>,
			<0x10033 0x1>, <0x10033 0x301>, <0x10033 0x401>, <0x10033 0x501>,
			<0x20033 0x1>, <0x20033 0x301>, <0x20033 0x401>, <0x20033 0x501>,
			<0x60033 0x1>, <0x60033 0x301>, <0x60033 0x401>, <0x60033 0x501>,
			<0x70033 0x1>, <0x70033 0x301>, <0x70033 0x401>, <0x70033 0x501>,
			<0x50033 0x0>,
			<0x10033 0x2>;
	qcom,msm-id = <756 0x10000>, <758 0x10000>;
};
